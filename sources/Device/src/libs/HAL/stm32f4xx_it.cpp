#include "stm32f4xx_hal.h"
#include "stm32f4xx.h"
#include "stm32f4xx_it.h"
#include "Hardware/Sound.h"
#include "Utils/Debug.h"


#ifdef MSVC
#define __attribute(x)
#endif


#ifdef __cplusplus
extern "C" {
#endif


//////////////////////////////////////////////////////////////////////////////////////////////////////////////////////////////////////////////////////
void NMI_Handler(void)
{
}

//----------------------------------------------------------------------------------------------------------------------------------------------------
void HardFault_Handler()
{
    __IO char *file = Debug::file;
    __IO int line = Debug::line;

    while (1)
    {
        file = file;
        line = line;
    }
}

//----------------------------------------------------------------------------------------------------------------------------------------------------
void MemManage_Handler()
{
  while (1)
  {
  }
}

//----------------------------------------------------------------------------------------------------------------------------------------------------
void BusFault_Handler()
{
  while (1)
  {
  }
}

//----------------------------------------------------------------------------------------------------------------------------------------------------
void UsageFault_Handler()
{
  while (1)
  {
  }
}

//----------------------------------------------------------------------------------------------------------------------------------------------------
void SVC_Handler(void)
{
}

//----------------------------------------------------------------------------------------------------------------------------------------------------
void DebugMon_Handler(void)
{
}

//----------------------------------------------------------------------------------------------------------------------------------------------------
void PendSV_Handler(void)
{
}

//----------------------------------------------------------------------------------------------------------------------------------------------------
void SysTick_Handler(void)
{
    HAL_IncTick();
}

//----------------------------------------------------------------------------------------------------------------------------------------------------
void EXTI9_5_IRQHandler(void)
{
    HAL_GPIO_EXTI_IRQHandler(GPIO_PIN_9);
}


#ifdef __cplusplus
}
#endif
